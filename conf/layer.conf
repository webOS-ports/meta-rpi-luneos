## conf/layer.conf
```bitbake
# We have a conf and classes directory, add to BBPATH
BBPATH .= ":${LAYERDIR}"

# We have recipes-* directories, add to BBFILES
BBFILES += "\
    ${LAYERDIR}/recipes-*/*/*.bb \
    ${LAYERDIR}/recipes-*/*/*.bbappend"

BBFILE_COLLECTIONS += "rpi-luneos"
BBFILE_PATTERN_rpi-luneos = "^${LAYERDIR}/"
BBFILE_PRIORITY_rpi-luneos = "20"

LAYERSERIES_COMPAT_rpi-luneos = "kirkstone"

LAYERDEPENDS_meta-webos-raspberrypi = "\
    meta-luneos \
    raspberrypi \
"

# Not compatible with our old Qt 5.6
BBMASK += "meta-raspberrypi/dynamic-layers/qt5-layer/recipes-qt/qt5/qtbase_%.bbappend"
```

## conf/machine/raspberrypi2.conf
```bitbake
#@TYPE: Machine
#@NAME: RaspberryPi 2 Development Board
#@DESCRIPTION: Machine configuration for the RaspberryPi 2

DEFAULTTUNE ?= "cortexa7thf-neon-vfpv4"

DTOVERLAY ?= "rpi-ft5406-overlay"
LCD_ROTATE ?= "2"
GPU_MEM ?= "256"
PREFERRED_VERSION_linux-raspberrypi ?= "4.9.%"
ARM_FREQ ?= "900"
CORE_FREQ ?= "450"
SDRAM_FREQ ?= "450"
DISABLE_SPLASH ?= "1"

require conf/machine/include/tune-cortexa7.inc
include conf/machine/include/rpi-base.inc

SERIAL_CONSOLE = "115200 ttyAMA0"

UBOOT_MACHINE = "rpi_2_config"
VC4_CMA_SIZE ?= "cma-256"

MACHINE_FEATURES_append_rpi = " vc4graphics"

IMAGE_FSTYPES = "rpi-sdimg.gz"
```

## conf/machine/raspberrypi3.conf
```bitbake
#@TYPE: Machine
#@NAME: RaspberryPi 3 Development Board
#@DESCRIPTION: Machine configuration for the RaspberryPi 3

DEFAULTTUNE ?= "cortexa7thf-neon-vfpv4"

MACHINE_EXTRA_RRECOMMENDS += "linux-firmware-brcm43430"
MACHINEOVERRIDES = "raspberrypi2:${MACHINE}"

DTOVERLAY ?= "rpi-ft5406-overlay"
LCD_ROTATE ?= "2"
GPU_MEM ?= "256"
PREFERRED_VERSION_linux-raspberrypi ?= "4.1.%"
ARM_FREQ ?= "1200"
CORE_FREQ ?= "450"
SDRAM_FREQ ?= "450"
DISABLE_SPLASH ?= "1"

require conf/machine/include/tune-cortexa7.inc
include conf/machine/include/rpi-base.inc

# Qt packages are machine specific due to RPi changes
QT_PACKAGES_ARCH = "${MACHINE_ARCH}"

KERNEL_DEVICETREE += " \
    overlays/rpi-ft5406-overlay.dtb \
"
```
